## packages/gmf_loader/Kconfigs/kconfig.audio_effects
```kconfig
menu "GMF Audio Effects"
    config GMF_AUDIO_EFFECT_INIT_ALC
        bool "Initialize GMF Audio Effect ALC"
        default y
        help
            Initialize GMF Audio effect alc

    config GMF_AUDIO_EFFECT_INIT_CH_CVT
        bool "Initialize GMF Audio Effect Channel Convert"
        default y
        help
            Initialize GMF Audio effect channel convert

        config GMF_AUDIO_EFFECT_CH_CVT_DEST_CH
            int "Channel Convert Destination Channel"
            depends on GMF_AUDIO_EFFECT_INIT_CH_CVT
            default 2
            help
                Channel number for output source stream

    config GMF_AUDIO_EFFECT_INIT_BIT_CVT
        bool "Initialize GMF Audio Effect Bit Convert"
        default y
        help
            Initialize GMF Audio effect bit convert

        config GMF_AUDIO_EFFECT_BIT_CVT_DEST_BITS
            int "Bit Convert Destination Bits"
            depends on GMF_AUDIO_EFFECT_INIT_BIT_CVT
            default 16
            help
                Audio sample bits of destination stream, supports unsigned 8 bits and signed 16, 24, 32 bits

    config GMF_AUDIO_EFFECT_INIT_RATE_CVT
        bool "Initialize GMF Audio Effect Rate Convert"
        default y
        help
            Initialize GMF Audio effect Rate Convert

        config GMF_AUDIO_EFFECT_RATE_CVT_DEST_RATE
            int "Rate Convert Destination Rate"
            depends on GMF_AUDIO_EFFECT_INIT_RATE_CVT
            default 44100
            help
                The sample rate of the output audio stream. It should be a multiple of 4000 or 11025.

        config GMF_AUDIO_EFFECT_RATE_CVT_COMPLEXITY
            int "Rate Convert Complexity"
            depends on GMF_AUDIO_EFFECT_INIT_RATE_CVT
            default 2
            range 1 3
            help
                Indicates the complexity of the resampling.
                Range: 1~3;
                1: lowest complexity (worst audio quality while fastest speed);
                3: highest complexity (best audio quality while slowest speed).

        choice GMF_AUDIO_EFFECT_RATE_CVT_PERF
            prompt "Rate Convert Performance Type"
            depends on GMF_AUDIO_EFFECT_INIT_RATE_CVT
            default GMF_AUDIO_EFFECT_RATE_CVT_PERF_TYPE_MEMORY
            help
                Select the performance type for rate conversion

            config GMF_AUDIO_EFFECT_RATE_CVT_PERF_TYPE_MEMORY
                bool "Memory Optimized"
                help
                    Lesser INRAM usage but higher CPU usage.

            config GMF_AUDIO_EFFECT_RATE_CVT_PERF_TYPE_SPEED
                bool "Speed Optimized"
                help
                    Higher INRAM usage but lower CPU usage
        endchoice

        config GMF_AUDIO_EFFECT_RATE_CVT_PERF_TYPE
            int
            default 0 if GMF_AUDIO_EFFECT_RATE_CVT_PERF_TYPE_MEMORY
            default 1 if GMF_AUDIO_EFFECT_RATE_CVT_PERF_TYPE_SPEED

    config GMF_AUDIO_EFFECT_INIT_DEINTERLEAVE
        bool "Initialize GMF Audio Effect Deinterleave"
        default n
        help
            Initialize GMF Audio effect deinterleave

    config GMF_AUDIO_EFFECT_INIT_INTERLEAVE
        bool "Initialize GMF Audio Effect Interleave"
        default n
        help
            Initialize GMF Audio effect interleave

    config GMF_AUDIO_EFFECT_INIT_MIXER
        bool "Initialize GMF Audio Effect Mixer"
        default n
        help
            Initialize GMF Audio effect mixer

    config GMF_AUDIO_EFFECT_INIT_EQ
        bool "Initialize GMF Audio Effect EQ"
        default n
        help
            Initialize GMF Audio effect EQ

    config GMF_AUDIO_EFFECT_INIT_SONIC
        bool "Initialize GMF Audio Effect SONIC"
        default n
        help
            Initialize GMF Audio effect sonic
    config GMF_AUDIO_EFFECT_INIT_FADE

    bool "Initialize GMF Audio Effect FADE"
        default n
        help
            Initialize GMF Audio effect fade
endmenu
```

## packages/gmf_loader/Kconfigs/kconfig.io.writer
```kconfig
menu "GMF IO Writer"
    config GMF_IO_INIT_CODEC_DEV_TX
        bool "Initialize GMF CODEC Device Writer"
        default y
        help
            Initialize GMF codec device writer

    config GMF_IO_INIT_FILE_WRITER
        bool "Initialize GMF File Writer"
        default y
        help
            Initialize GMF file writer

    config GMF_IO_INIT_HTTP_WRITER
        bool "Initialize GMF HTTP Writer"
        default n
        help
            Initialize GMF HTTP Writer

        menu "HTTP Writer Configuration"
            depends on GMF_IO_INIT_HTTP_WRITER

            config GMF_IO_HTTP_WRITER_TASK_STACK
                int "HTTP Writer Task Stack Size"
                default 3072
                range 1024 16384
                help
                    Configure the task stack size for the GMF HTTP Writer.

            config GMF_IO_HTTP_WRITER_TASK_CORE
                int "HTTP Writer Task Core"
                default 0
                range 0 1
                help
                    Configure the core on which the GMF HTTP Writer task will run.

            config GMF_IO_HTTP_WRITER_TASK_PRIORITY
                int "HTTP Writer Task Priority"
                default 5
                range 1 10
                help
                    Configure the task priority for the GMF HTTP Writer.

            config GMF_IO_HTTP_WRITER_STACK_IN_EXT
                bool "HTTP Writer Stack in External Memory"
                default n
                help
                    Enable this option to allocate the HTTP Writer stack in external memory.

            config GMF_IO_HTTP_WRITER_OUT_BUF_SIZE
                int "HTTP Writer Output Buffer Size"
                default 8192
                range 1024 16384
                help
                    Configure the size of the output buffer for the GMF HTTP Writer.

            config GMF_IO_HTTP_WRITER_CERT_PEM
                string "HTTP Writer SSL Certificate (PEM)"
                default ""
                help
                    Provide the SSL server certificate in PEM format for the GMF HTTP Writer.
        endmenu
endmenu
```

## packages/gmf_loader/Kconfigs/kconfig.video_effects
```kconfig
menu "GMF Video Effects"

    config GMF_VIDEO_EFFECTS_INIT_PPA
        bool "Initialize Video PPA"
        default n
        help
            Initialize the video PPA element.

    config GMF_VIDEO_EFFECTS_INIT_FPS_CONVERT
        bool "Initialize Video FPS Convert"
        default n
        help
            Initialize the video FPS convert element.

    config GMF_VIDEO_EFFECTS_INIT_OVERLAY
        bool "Initialize Video Overlay"
        default n
        help
            Initialize the video overlay element.

endmenu
```

## packages/gmf_loader/test_apps/sdkconfig.defaults
```kconfig
# General options for additional checks
CONFIG_COMPILER_WARN_WRITE_STRINGS=y
CONFIG_BOOTLOADER_LOG_LEVEL_WARN=y
CONFIG_FREERTOS_WATCHPOINT_END_OF_STACK=y
CONFIG_COMPILER_STACK_CHECK_MODE_STRONG=y
CONFIG_COMPILER_STACK_CHECK=y

CONFIG_ESPTOOLPY_FLASHFREQ_80M=y
CONFIG_ESPTOOLPY_FLASHFREQ="80m"
CONFIG_ESPTOOLPY_FLASHSIZE_8MB=y
CONFIG_ESPTOOLPY_FLASHSIZE="8MB"

#
# Partition Table
#
CONFIG_PARTITION_TABLE_CUSTOM=y
CONFIG_PARTITION_TABLE_CUSTOM_FILENAME="partitions.csv"
CONFIG_PARTITION_TABLE_FILENAME="partitions.csv"
CONFIG_PARTITION_TABLE_OFFSET=0x8000
CONFIG_PARTITION_TABLE_MD5=y
# end of Partition Table

# disable task watchdog since this app uses an interactive menu
CONFIG_ESP_TASK_WDT_INIT=n

# some tests verify file name encoding
CONFIG_FATFS_LFN_HEAP=y
CONFIG_FATFS_API_ENCODING_UTF_8=y
CONFIG_FATFS_CODEPAGE_936=y

CONFIG_ESP_GDBSTUB_ENABLED=y

CONFIG_FREERTOS_HZ=1000
CONFIG_COMPILER_OPTIMIZATION_PERF=y

CONFIG_SPIRAM=y

CONFIG_CODEC_I2C_BACKWARD_COMPATIBLE=n

CONFIG_LOG_DEFAULT_LEVEL_DEBUG=y
CONFIG_LOG_DEFAULT_LEVEL=4
CONFIG_UNITY_ENABLE_64BIT=y
```
