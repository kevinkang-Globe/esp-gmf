## elements/test_apps/sdkconfig.defaults
```kconfig
# General options for additional checks
CONFIG_HEAP_POISONING_COMPREHENSIVE=y
CONFIG_COMPILER_WARN_WRITE_STRINGS=y
CONFIG_BOOTLOADER_LOG_LEVEL_WARN=y
CONFIG_FREERTOS_WATCHPOINT_END_OF_STACK=y
CONFIG_COMPILER_STACK_CHECK_MODE_STRONG=y
CONFIG_COMPILER_STACK_CHECK=y

# Serial flasher config
CONFIG_ESPTOOLPY_FLASHSIZE_8MB=y
CONFIG_ESPTOOLPY_FLASHSIZE="8MB"

# disable task watchdog since this app uses an interactive menu
CONFIG_ESP_TASK_WDT_INIT=n

# some tests verify file name encoding
CONFIG_FATFS_LFN_HEAP=y
CONFIG_FATFS_API_ENCODING_UTF_8=y
CONFIG_FATFS_CODEPAGE_936=y

# some of the tests verify concurrent operation of FAT partitions in
# an SD card and in Flash, so need to use a custom partition table.
CONFIG_PARTITION_TABLE_CUSTOM=y
CONFIG_PARTITION_TABLE_CUSTOM_FILENAME="partitions.csv"

CONFIG_ESP_GDBSTUB_ENABLED=y

CONFIG_ESP_WIFI_STATIC_RX_BUFFER_NUM=20
CONFIG_ESP_WIFI_DYNAMIC_RX_BUFFER_NUM=128
CONFIG_ESP_WIFI_DYNAMIC_TX_BUFFER_NUM=128
CONFIG_ESP_WIFI_AMPDU_TX_ENABLED=y
CONFIG_ESP_WIFI_TX_BA_WIN=32
CONFIG_ESP_WIFI_AMPDU_RX_ENABLED=y
CONFIG_ESP_WIFI_RX_BA_WIN=32

# CONFIG_ESP_WIFI_IRAM_OPT is not set
# CONFIG_ESP_WIFI_EXTRA_IRAM_OPT is not set
# CONFIG_ESP_WIFI_RX_IRAM_OPT is not set
# CONFIG_ESP_WIFI_SLP_IRAM_OPT is not set
# CONFIG_LWIP_IRAM_OPTIMIZATION=y

CONFIG_LWIP_TCP_SND_BUF_DEFAULT=65535
CONFIG_LWIP_TCP_WND_DEFAULT=65535
CONFIG_LWIP_TCP_RECVMBOX_SIZE=64
CONFIG_LWIP_UDP_RECVMBOX_SIZE=64
CONFIG_LWIP_TCPIP_RECVMBOX_SIZE=64

CONFIG_FREERTOS_HZ=1000
CONFIG_COMPILER_OPTIMIZATION_PERF=y

CONFIG_ESPTOOLPY_FLASHMODE_QIO=y
CONFIG_ESPTOOLPY_FLASHFREQ_80M=y

CONFIG_SPIRAM=y
CONFIG_FREERTOS_ENABLE_BACKWARD_COMPATIBILITY=y

CONFIG_CODEC_I2C_BACKWARD_COMPATIBLE=n

CONFIG_LOG_DEFAULT_LEVEL_DEBUG=y
CONFIG_LOG_DEFAULT_LEVEL=4
CONFIG_UNITY_ENABLE_64BIT=y

#
# GMF Video Configurations
#

#
# GMF Video Codec
#
CONFIG_GMF_VIDEO_CODEC_INIT_DECODER=y
CONFIG_GMF_VIDEO_DEC_CODEC_TYPE_AUTO=y
CONFIG_GMF_VIDEO_DEC_CODEC_TYPE=0x00000000
CONFIG_GMF_VIDEO_CODEC_INIT_ENCODER=y
CONFIG_GMF_VIDEO_ENC_CODEC_TYPE_AUTO=y
CONFIG_GMF_VIDEO_ENC_CODEC_TYPE=0x00000000
# end of GMF Video Codec

#
# GMF Video Effects
#
CONFIG_GMF_VIDEO_EFFECTS_INIT_FPS_CONVERT=y
CONFIG_GMF_VIDEO_EFFECTS_INIT_OVERLAY=y
CONFIG_GMF_VIDEO_EFFECTS_INIT_COLOR_CONVERT=y

#
# Video effects color convert Configuration
#
CONFIG_GMF_VIDEO_EFFECTS_CC_INPUT_WIDTH=320
CONFIG_GMF_VIDEO_EFFECTS_CC_INPUT_HEIGHT=240
CONFIG_GMF_VIDEO_EFFECTS_CC_INPUT_FMT_GREY=y
CONFIG_GMF_VIDEO_EFFECTS_CC_INPUT_PIXEL_FORMAT=0x59455247
CONFIG_GMF_VIDEO_EFFECTS_CC_OUTPUT_FMT_RGB565_LE=y
CONFIG_GMF_VIDEO_EFFECTS_CC_OUTPUT_PIXEL_FORMAT=0x4C424752
CONFIG_GMF_VIDEO_EFFECTS_CC_COLOR_SPACE_BT601=y
CONFIG_GMF_VIDEO_EFFECTS_CC_COLOR_SPACE=0
# end of Video effects color convert Configuration

CONFIG_GMF_VIDEO_EFFECTS_INIT_SCALE=y

#
# Video effects scale Configuration
#
CONFIG_GMF_VIDEO_EFFECTS_SCALE_INPUT_WIDTH=320
CONFIG_GMF_VIDEO_EFFECTS_SCALE_INPUT_HEIGHT=240
CONFIG_GMF_VIDEO_EFFECTS_SCALE_INPUT_FMT_RGB565_LE=y
CONFIG_GMF_VIDEO_EFFECTS_SCALE_INPUT_PIXEL_FORMAT=0x4C424752
CONFIG_GMF_VIDEO_EFFECTS_SCALE_OUTPUT_WIDTH=160
CONFIG_GMF_VIDEO_EFFECTS_SCALE_OUTPUT_HEIGHT=120
CONFIG_GMF_VIDEO_EFFECTS_SCALE_FILTER_DOWN_RESAMPLE=y
CONFIG_GMF_VIDEO_EFFECTS_SCALE_FILTER_TYPE=0
# end of Video effects scale Configuration

CONFIG_GMF_VIDEO_EFFECTS_INIT_CROP=y

#
# Video effects crop Configuration
#
CONFIG_GMF_VIDEO_EFFECTS_CROP_INPUT_WIDTH=320
CONFIG_GMF_VIDEO_EFFECTS_CROP_INPUT_HEIGHT=240
CONFIG_GMF_VIDEO_EFFECTS_CROP_INPUT_FMT_RGB565_LE=y
CONFIG_GMF_VIDEO_EFFECTS_CROP_INPUT_PIXEL_FORMAT=0x4C424752
CONFIG_GMF_VIDEO_EFFECTS_CROP_X_POS=0
CONFIG_GMF_VIDEO_EFFECTS_CROP_Y_POS=0
CONFIG_GMF_VIDEO_EFFECTS_CROP_OUTPUT_WIDTH=160
CONFIG_GMF_VIDEO_EFFECTS_CROP_OUTPUT_HEIGHT=120
# end of Video effects crop Configuration

CONFIG_GMF_VIDEO_EFFECTS_INIT_ROTATE=y

#
# Video effects rotate Configuration
#
CONFIG_GMF_VIDEO_EFFECTS_ROTATE_INPUT_WIDTH=320
CONFIG_GMF_VIDEO_EFFECTS_ROTATE_INPUT_HEIGHT=240
CONFIG_GMF_VIDEO_EFFECTS_ROTATE_INPUT_FMT_RGB565_LE=y
CONFIG_GMF_VIDEO_EFFECTS_ROTATE_INPUT_PIXEL_FORMAT=0x4C424752
CONFIG_GMF_VIDEO_EFFECTS_ROTATE_DEGREE=0
# end of Video effects rotate Configuration
# end of GMF Video Effects
# end of GMF Video Configurations
# end of ESP GMF Loader
```

## elements/test_apps/sdkconfig.defaults.esp32p4
```kconfig
# Flash setting
CONFIG_FLASHMODE_QIO=y
CONFIG_ESPTOOLPY_FLASHSIZE_8MB=y

CONFIG_SPIRAM_SPEED_200M=y

# If you use serial JTAG turn on this option
#CONFIG_ESP_CONSOLE_USB_SERIAL_JTAG=y

# Use camera SC2336
CONFIG_CAMERA_SC2336=y
CONFIG_CAMERA_SC2336_MIPI_RAW8_1024x600_30FPS=y

# Enable ISP pipelines
CONFIG_ESP_VIDEO_ENABLE_ISP_PIPELINE_CONTROLLER=y

# Set Slave target type
CONFIG_IDF_SLAVE_TARGET="esp32c6"
CONFIG_SLAVE_IDF_TARGET_ESP32C6=y

#
# Partition Table
#
CONFIG_PARTITION_TABLE_CUSTOM=y
CONFIG_PARTITION_TABLE_CUSTOM_FILENAME="partitions_esp32p4.csv"
CONFIG_PARTITION_TABLE_FILENAME="partitions_esp32p4.csv"
CONFIG_PARTITION_TABLE_OFFSET=0x8000
CONFIG_PARTITION_TABLE_MD5=y
# end of Partition Table

CONFIG_HEAP_POISONING_COMPREHENSIVE=n
CONFIG_HEAP_POISONING_LIGHT=y

CONFIG_GMF_VIDEO_EFFECTS_INIT_PPA=y
```

## elements/test_apps/sdkconfig.defaults.esp32s3
```kconfig
CONFIG_IDF_CMAKE=y
CONFIG_IDF_TARGET_ARCH_XTENSA=y
CONFIG_IDF_TARGET="esp32s3"
CONFIG_IDF_TARGET_ESP32S3=y
CONFIG_IDF_FIRMWARE_CHIP_ID=0x0009

#
# SDK tool configuration
#
CONFIG_SDK_TOOLPREFIX="xtensa-esp32s3-elf-"
# CONFIG_SDK_TOOLCHAIN_SUPPORTS_TIME_WIDE_64_BITS is not set
# end of SDK tool configuration

CONFIG_ESPTOOLPY_FLASHFREQ_80M=y
CONFIG_ESPTOOLPY_FLASHFREQ_80M_DEFAULT=y
CONFIG_ESPTOOLPY_FLASHFREQ="80m"
CONFIG_ESPTOOLPY_FLASHSIZE_8MB=y
CONFIG_ESPTOOLPY_FLASHSIZE="8MB"

#
# Partition Table
#
CONFIG_PARTITION_TABLE_CUSTOM=y
CONFIG_PARTITION_TABLE_CUSTOM_FILENAME="partitions_esp32s3.csv"
CONFIG_PARTITION_TABLE_FILENAME="partitions_esp32s3.csv"
CONFIG_PARTITION_TABLE_OFFSET=0x8000
CONFIG_PARTITION_TABLE_MD5=y
# end of Partition Table

#
# ESP Speech Recognition
#
CONFIG_MODEL_IN_FLASH=y
CONFIG_AFE_INTERFACE_V1=y
CONFIG_SR_NSN_WEBRTC=y
CONFIG_SR_VADN_WEBRTC=y
CONFIG_SR_WN_WN9_HILEXIN=y
CONFIG_SR_MN_CN_MULTINET6_QUANT=y
CONFIG_SR_MN_EN_NONE=y

CONFIG_ESP32_S3_KORVO2_V3_BOARD=y

CONFIG_SPIRAM_SPEED_80M=y
CONFIG_SPIRAM_TRY_ALLOCATE_WIFI_LWIP=y
CONFIG_SPIRAM_ALLOW_STACK_EXTERNAL_MEMORY=y
CONFIG_SPIRAM_MALLOC_ALWAYSINTERNAL=1024
CONFIG_SPIRAM_FETCH_INSTRUCTIONS=y
CONFIG_SPIRAM_MODE_OCT=y
CONFIG_SPIRAM_TYPE_AUTO=y

CONFIG_MBEDTLS_INTERNAL_MEM_ALLOC=y
CONFIG_ESP_TLS_SERVER=y
CONFIG_ESP_TLS_INSECURE=y
CONFIG_ESP_TLS_SKIP_SERVER_CERT_VERIFY=y

CONFIG_ESP32S3_DEFAULT_CPU_FREQ_240=y
CONFIG_ESP32S3_INSTRUCTION_CACHE_32KB=y
CONFIG_ESP32S3_DATA_CACHE_LINE_64B=y

CONFIG_EXAMPLE_SDMMC_BUS_WIDTH_1=y
```

## gmf_elements/test_apps/sdkconfig.defaults
```kconfig
# General options for additional checks
CONFIG_HEAP_POISONING_COMPREHENSIVE=y
CONFIG_COMPILER_WARN_WRITE_STRINGS=y
CONFIG_BOOTLOADER_LOG_LEVEL_WARN=y
CONFIG_FREERTOS_WATCHPOINT_END_OF_STACK=y
CONFIG_COMPILER_STACK_CHECK_MODE_STRONG=y
CONFIG_COMPILER_STACK_CHECK=y

# Serial flasher config
CONFIG_ESPTOOLPY_FLASHSIZE_4MB=y
CONFIG_ESPTOOLPY_FLASHSIZE="4MB"

# disable task watchdog since this app uses an interactive menu
CONFIG_ESP_TASK_WDT_INIT=n

# some tests verify file name encoding
CONFIG_FATFS_LFN_HEAP=y
CONFIG_FATFS_API_ENCODING_UTF_8=y
CONFIG_FATFS_CODEPAGE_936=y

# some of the tests verify concurrent operation of FAT partitions in
# an SD card and in Flash, so need to use a custom partition table.
CONFIG_PARTITION_TABLE_CUSTOM=y
CONFIG_PARTITION_TABLE_CUSTOM_FILENAME="partitions.csv"

CONFIG_ESP_GDBSTUB_ENABLED=y

CONFIG_ESP_WIFI_STATIC_RX_BUFFER_NUM=20
CONFIG_ESP_WIFI_DYNAMIC_RX_BUFFER_NUM=128
CONFIG_ESP_WIFI_DYNAMIC_TX_BUFFER_NUM=128
CONFIG_ESP_WIFI_AMPDU_TX_ENABLED=y
CONFIG_ESP_WIFI_TX_BA_WIN=32
CONFIG_ESP_WIFI_AMPDU_RX_ENABLED=y
CONFIG_ESP_WIFI_RX_BA_WIN=32

# CONFIG_ESP_WIFI_IRAM_OPT is not set
# CONFIG_ESP_WIFI_EXTRA_IRAM_OPT is not set
# CONFIG_ESP_WIFI_RX_IRAM_OPT is not set
# CONFIG_ESP_WIFI_SLP_IRAM_OPT is not set
# CONFIG_LWIP_IRAM_OPTIMIZATION=y

CONFIG_LWIP_TCP_SND_BUF_DEFAULT=65535
CONFIG_LWIP_TCP_WND_DEFAULT=65535
CONFIG_LWIP_TCP_RECVMBOX_SIZE=64
CONFIG_LWIP_UDP_RECVMBOX_SIZE=64
CONFIG_LWIP_TCPIP_RECVMBOX_SIZE=64

CONFIG_FREERTOS_HZ=1000
CONFIG_COMPILER_OPTIMIZATION_PERF=y

CONFIG_ESPTOOLPY_FLASHMODE_QIO=y
CONFIG_ESPTOOLPY_FLASHFREQ_80M=y

CONFIG_SPIRAM=y
CONFIG_FREERTOS_ENABLE_BACKWARD_COMPATIBILITY=y

CONFIG_CODEC_I2C_BACKWARD_COMPATIBLE=n

CONFIG_LOG_DEFAULT_LEVEL_DEBUG=y
CONFIG_LOG_DEFAULT_LEVEL=4
CONFIG_UNITY_ENABLE_64BIT=y
```

## gmf_examples/system_common/Kconfig.projbuild
```kconfig
menu "Example Configuration"
    menu "WiFi Configuration"
        config EXAMPLE_ESP_GMF_WIFI
            bool "Enable My Wifi"
            default y

        config EXAMPLE_ESP_GMF_WIFI_SSID
            string "wifi_ssid"
            depends on EXAMPLE_ESP_GMF_WIFI
            default "wifi_ssid"
            help
                SSID (network name) for the example to connect to.

        config EXAMPLE_ESP_GMF_WIFI_PASS
            string "wifi_password"
            depends on EXAMPLE_ESP_GMF_WIFI
            default "wifi_password"
            help
                WiFi password (WPA or WPA2) for the example to use.

                Can be left blank if the network has no security set.
    endmenu
endmenu
```

## packages/gmf_loader/Kconfig.projbuild
```kconfig
menu "ESP GMF Loader"

    rsource "Kconfigs/kconfig.io"
    rsource "Kconfigs/kconfig.audio"
    rsource "Kconfigs/kconfig.video"

endmenu
```

## packages/gmf_loader/Kconfigs/kconfig.ai_audio
```kconfig
menu "GMF AI Audio"
    config GMF_AI_AUDIO_INIT_AEC
        bool "Initialize GMF AI Audio AEC"
        default y
        help
            Enable initialization of the GMF AEC (Automatic Echo Cancellation) element and its insertion into the user pool

    config GMF_AI_AUDIO_AEC_FILTER_LEN
        int
        depends on GMF_AI_AUDIO_INIT_AEC
        default 4 if IDF_TARGET="esp32s3"
        default 4 if IDF_TARGET="esp32p4"
        default 2
        help
            Filter length for the GMF AEC element, determined by the IDF target

    config GMF_AI_AUDIO_AEC_CH_ALLOCATION
        string "AFE Channel Allocation"
        depends on GMF_AI_AUDIO_INIT_AEC
        default "RMNM"
        help
            Format string of the channel Allocation:
            `M` to represent the microphone channel,
            `R` to represent the playback reference channel,
            `N` to represent an unknown or unused channel

    config GMF_AI_AUDIO_INIT_AFE
        bool "Initialize GMF AI Audio AFE"
        default n
        help
            Enable initialization of the GMF AFE (Automatic Front-End) element and its insertion into the user pool

    menu "FEED Task Setting"
        depends on GMF_AI_AUDIO_INIT_AFE

        config GMF_AI_AUDIO_FEED_TASK_CORE_ID
            int "FEED Task Core ID"
            default 0
            range 0 1
            help
                Specifies which CPU core (0 or 1) the FEED task will run on

        config GMF_AI_AUDIO_FEED_TASK_PRIORITY
            int "FEED Task Priority"
            default 5
            range 0 23
            help
                Sets the FreeRTOS task priority for the FEED task

        config GMF_AI_AUDIO_FEED_TASK_STACK_SIZE
            int "FEED Task Stack Size"
            default 3072
            range 1024 16384
            help
                Defines the stack size in bytes for the FEED task
    endmenu

    menu "Fetch Task Setting"
        depends on GMF_AI_AUDIO_INIT_AFE

        config GMF_AI_AUDIO_FETCH_TASK_CORE_ID
            int "Fetch Task Core ID"
            default 1
            range 0 1
            help
                Specifies which CPU core (0 or 1) the FETCH task will run on

        config GMF_AI_AUDIO_FETCH_TASK_PRIORITY
            int "Fetch Task Priority"
            default 5
            range 0 23
            help
                Sets the FreeRTOS task priority for the FETCH task

        config GMF_AI_AUDIO_FETCH_TASK_STACK_SIZE
            int "Fetch Task Stack Size"
            default 3072
            range 1024 16384
            help
                Defines the stack size in bytes for the FETCH task
    endmenu

    config GMF_AI_AUDIO_AFE_CH_ALLOCATION
        string "AFE Channel Allocation"
        depends on GMF_AI_AUDIO_INIT_AFE
        default "RMNM"
        help
            Format string of the channel Allocation:
            `M` to represent the microphone channel,
            `R` to represent the playback reference channel,
            `N` to represent an unknown or unused channel

    config GMF_AI_AUDIO_AFE_MODEL_PARTITION
        string "Model Partition Name"
        depends on GMF_AI_AUDIO_INIT_AFE
        default "model"
        help
            Specifies the name of the partition where the AI model is stored

    config GMF_AI_AUDIO_AFE_VAD_ENABLE
        bool "VAD Detection Enable"
        depends on GMF_AI_AUDIO_INIT_AFE
        default y
        help
            Enables Voice Activity Detection (VAD) in the AFE pipeline

    config GMF_AI_AUDIO_VAD_MODE
        int "VAD mode"
        depends on GMF_AI_AUDIO_AFE_VAD_ENABLE
        default 3 if IDF_TARGET="esp32s3"
        default 3 if IDF_TARGET="esp32p4"
        default 2
        range 0 4
        help
            Sets the VAD detection mode (0-4)

    config GMF_AI_AUDIO_VAD_MIN_SPEECH
        int "Minimum Duration of Speech (ms)"
        depends on GMF_AI_AUDIO_AFE_VAD_ENABLE
        default 128
        range 32 1000
        help
            Minimum duration in milliseconds that audio must be classified as speech
            before triggering a speech event

    config GMF_AI_AUDIO_VAD_MIN_NOISE
        int "Minimum Duration of Noise (ms)"
        depends on GMF_AI_AUDIO_AFE_VAD_ENABLE
        default 1000
        range 64 10000
        help
            Minimum duration in milliseconds that audio must be classified as noise
            before triggering a noise event

    config GMF_AI_AUDIO_AFE_AEC_ENABLE
        bool "AFE Internal AEC Enable"
        depends on GMF_AI_AUDIO_INIT_AFE
        default n
        help
            Enables the internal AEC in the AFE pipeline

    config GMF_AI_AUDIO_WAKEUP_ENABLE
        bool "Wakeup Detection Enable"
        depends on GMF_AI_AUDIO_INIT_AFE
        default n
        help
            Enables wake word detection functionality in the AFE pipeline

    config GMF_AI_AUDIO_VOICE_COMMAND_ENABLE
        bool "Voice Command Detection Enable"
        depends on GMF_AI_AUDIO_INIT_AFE
        default n
        help
            Enables voice command detection functionality in the AFE pipeline
endmenu
```
